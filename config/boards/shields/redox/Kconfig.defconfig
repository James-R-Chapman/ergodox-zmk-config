## config/boards/shields/redox/Kconfig.defconfig
```kconfig
if SHIELD_REDOX_DONGLE

config ZMK_KEYBOARD_NAME
    default "REDOX"
    
config ZMK_SPLIT_ROLE_CENTRAL
    default y

config ZMK_SPLIT_BLE_CENTRAL_PERIPHERALS
    default 2

config ZMK_USB
    default y

config ZMK_SPLIT
	default y

config ZMK_BLE
    default y

endif

if SHIELD_REDOX_LEFT || SHIELD_REDOX_RIGHT

config ZMK_SPLIT
	default y

config ZMK_BLE
    default y

endif
```
