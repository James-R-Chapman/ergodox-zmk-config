/*
 * Copyright (c) 2022 The ZMK Contributors
 *
 * SPDX-License-Identifier: MIT
 */

#include "redox.dtsi"

&kscan0 {
    compatible = "zmk,kscan-gpio-matrix";
    wakeup-source;

    /* 7 scan columns for left half (promicro_nrf52840 raw GPIOs) */
    col-gpios
        = <&gpio0 31 GPIO_ACTIVE_HIGH>  /* D21 */
        , <&gpio0 29 GPIO_ACTIVE_HIGH>  /* D20 */
        , <&gpio0 2 GPIO_ACTIVE_HIGH>   /* D19 */
        , <&gpio1 15 GPIO_ACTIVE_HIGH>  /* D18 */
        , <&gpio1 13 GPIO_ACTIVE_HIGH>  /* D15 */
        , <&gpio1 11 GPIO_ACTIVE_HIGH>  /* D14 */
        , <&gpio0 10 GPIO_ACTIVE_HIGH>  /* D16 */
        ;

    /* 5 scan rows (promicro_nrf52840 raw GPIOs) */
    row-gpios
        = <&gpio0 22 (GPIO_ACTIVE_HIGH | GPIO_PULL_DOWN)> /* D4 */
        , <&gpio0 24 (GPIO_ACTIVE_HIGH | GPIO_PULL_DOWN)> /* D5 */
        , <&gpio1 0 (GPIO_ACTIVE_HIGH | GPIO_PULL_DOWN)>  /* D6 */
        , <&gpio0 11 (GPIO_ACTIVE_HIGH | GPIO_PULL_DOWN)> /* D7 */
        , <&gpio1 4 (GPIO_ACTIVE_HIGH | GPIO_PULL_DOWN)>  /* D8 */
        ;
};
